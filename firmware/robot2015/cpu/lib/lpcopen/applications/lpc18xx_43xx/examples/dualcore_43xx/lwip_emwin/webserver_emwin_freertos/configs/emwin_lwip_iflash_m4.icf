/*###ICF### Section handled by ICF editor, don't touch! ****/
/*-Editor annotation file-*/
/* IcfEditorFile="$TOOLKIT_DIR$\config\ide\IcfEditor\cortex_v1_0.xml" */
/*-Specials-*/
define symbol __ICFEDIT_intvec_start__ = 0x1A000000;
/*-Memory Regions-*/
define symbol __ICFEDIT_region_ROM_start__ = 0x1A000000;
define symbol __ICFEDIT_region_ROM_end__   = 0x1A03FFFF;
define symbol __ICFEDIT_region_RAM_start__ = 0x10000000;
define symbol __ICFEDIT_region_RAM_end__   = 0x10007FFF;
/*-Sizes-*/
define symbol __ICFEDIT_size_cstack__ = 0x400;
define symbol __ICFEDIT_size_heap__   = 0x4000;
/**** End of ICF editor section. ###ICF###*/

define symbol XTRA_RAM_start__ = 0x20004000; /* AHB_SRAM1_start__ */
define symbol XTRA_RAM_end__   = 0x2000FFFF; /* AHB_SRAM1_end__ */

include "..\..\..\common\linker_scripts\lpc43xx_dualcore_xtraram.icf";